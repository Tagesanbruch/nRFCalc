## CMakeLists.txt
```
# SPDX-License-Identifier: Apache-2.0

cmake_minimum_required(VERSION 3.20.0)
find_package(Zephyr REQUIRED HINTS $ENV{ZEPHYR_BASE})
project(display)

# Automatically find all C source files in src/ and subdirectories
file(GLOB_RECURSE APP_SOURCES 
    src/*.c
)

# Add all discovered source files to the target
target_sources(app PRIVATE ${APP_SOURCES})

# Optional: Print discovered source files for debugging (can be removed later)
message(STATUS "Discovered source files: ${APP_SOURCES}")
```

## prj.conf
```kconfig
# SPDX-License-Identifier: Apache-2.0

# Basic Zephyr settings
CONFIG_LOG=y
CONFIG_DISPLAY=y

# Increase heap size for native_sim to accommodate the display buffer
CONFIG_MAIN_STACK_SIZE=4096
CONFIG_HEAP_MEM_POOL_SIZE=500000
```

## src/main.c
```c
/*
 * Scientific Calculator Application
 * 
 * A modular calculator implementation using Zephyr RTOS with:
 * - Abstract display engine for various pixel formats
 * - Unified keypad handler supporting SDL simulation and hardware GPIO
 * - Mathematical expression evaluator with basic operations
 *
 * Copyright (c) 2019 Jan Van Winkel <jan.van_winkel@dxplore.eu>
 * Modified for calculator application
 *
 * SPDX-License-Identifier: Apache-2.0
 */

#include <zephyr/logging/log.h>
LOG_MODULE_REGISTER(calculator_main, LOG_LEVEL_INF);

#include <zephyr/kernel.h>
#include "display_engine.h"
#include "keypad_handler.h" 
#include "calculator_core.h"

#ifdef CONFIG_ARCH_POSIX
#include "posix_board_if.h"
#endif

#ifdef CONFIG_ARCH_POSIX
static void posix_exit_main(int exit_code)
{
#if CONFIG_TEST
	if (exit_code == 0) {
		LOG_INF("PROJECT EXECUTION SUCCESSFUL");
	} else {
		LOG_INF("PROJECT EXECUTION FAILED");
	}
#endif
	posix_exit(exit_code);
}
#endif

int main(void)
{
	calculator_t calc;

	LOG_INF("Starting Scientific Calculator application");

	if (display_engine_init() != 0) {
		LOG_ERR("Failed to initialize display engine. Aborting.");
#ifdef CONFIG_ARCH_POSIX
		posix_exit_main(1);
#else
		return 1;
#endif
	}

	if (keypad_init() != 0) {
		LOG_ERR("Failed to initialize keypad handler. Aborting.");
#ifdef CONFIG_ARCH_POSIX
		posix_exit_main(1);
#else
		return 1;
#endif
	}

	calculator_init(&calc);

	while (1) {
		// 1. Get input
		key_code_t key = keypad_get_key();

		// 2. Update state and data (process key press)
		if (key != KEY_NONE) {
			LOG_INF("Processing key: %d", key);
		}
		calculator_update_state(&calc, key);

		// 3. Render UI
		calculator_render_ui(&calc);

		// 4. Yield to other threads - reduced for better responsiveness
		k_msleep(20);
	}

#ifdef CONFIG_ARCH_POSIX
	posix_exit_main(0);
#endif
	return 0;
}
```

## src/calculator_core.c
```c
/*
 * Calculator Core Implementation
 * 
 * This module implements the calculator state machine, input handling,
 * and basic mathematical expression evaluation.
 */

#include "calculator_core.h"
#include "display_engine.h"

#include <zephyr/kernel.h>
#include <zephyr/logging/log.h>
#include <string.h>
#include <stdio.h>
#include <stdlib.h>
#include <math.h>

LOG_MODULE_REGISTER(calculator_core, LOG_LEVEL_INF);

void calculator_init(struct calculator *calc)
{
    memset(calc, 0, sizeof(*calc));
    calc->state = STATE_INPUT_NORMAL;
    calc->mode.deg_mode = true;  // Default to degree mode
    strcpy(calc->input_buffer, "0");
    strcpy(calc->status_buffer, "COMP");
    calc->input_pos = 1;
    calc->new_number = true;
}

static void clear_input(struct calculator *calc)
{
    memset(calc->input_buffer, 0, sizeof(calc->input_buffer));
    strcpy(calc->input_buffer, "0");
    calc->input_pos = 1;
    calc->new_number = true;
}

static void append_char(struct calculator *calc, char ch)
{
    if (calc->new_number) {
        // Starting a new number, clear the display
        clear_input(calc);
        calc->new_number = false;
    }
    
    // Remove leading zero if we're entering the first digit
    if (calc->input_pos == 1 && calc->input_buffer[0] == '0' && ch != '.') {
        calc->input_buffer[0] = ch;
        return;
    }
    
    if (calc->input_pos < sizeof(calc->input_buffer) - 1) {
        calc->input_buffer[calc->input_pos++] = ch;
        calc->input_buffer[calc->input_pos] = '\0';
    }
}

static void append_operator(struct calculator *calc, char op)
{
    // If we're showing a result, use it as the start of new expression
    if (calc->state == STATE_SHOW_RESULT) {
        snprintf(calc->input_buffer, sizeof(calc->input_buffer), 
                 "%.10g%c", calc->last_result, op);
        calc->input_pos = strlen(calc->input_buffer);
        calc->state = STATE_INPUT_NORMAL;
        calc->new_number = false;
        return;
    }
    
    // Don't allow operators at the beginning (except minus)
    if (calc->input_pos == 0 && op != '-') {
        return;
    }
    
    // Replace last character if it's already an operator
    if (calc->input_pos > 0) {
        char last_char = calc->input_buffer[calc->input_pos - 1];
        if (last_char == '+' || last_char == '-' || last_char == '*' || last_char == '/') {
            calc->input_buffer[calc->input_pos - 1] = op;
            return;
        }
    }
    
    if (calc->input_pos < sizeof(calc->input_buffer) - 1) {
        calc->input_buffer[calc->input_pos++] = op;
        calc->input_buffer[calc->input_pos] = '\0';
    }
    calc->new_number = false;
}

static void backspace(struct calculator *calc)
{
    if (calc->state == STATE_SHOW_RESULT || calc->state == STATE_SHOW_ERROR) {
        // Return to input mode
        clear_input(calc);
        calc->state = STATE_INPUT_NORMAL;
        return;
    }
    
    if (calc->input_pos > 1) {
        calc->input_buffer[--calc->input_pos] = '\0';
    } else {
        clear_input(calc);
    }
}

void calculator_update_state(struct calculator *calc, key_code_t key)
{
    if (!calc || key == KEY_NONE) {
        return;
    }
    
    switch (key) {
    case KEY_0: case KEY_1: case KEY_2: case KEY_3: case KEY_4:
    case KEY_5: case KEY_6: case KEY_7: case KEY_8: case KEY_9:
        if (calc->state != STATE_INPUT_NORMAL) {
            calc->state = STATE_INPUT_NORMAL;
            clear_input(calc);
        }
        append_char(calc, '0' + (key - KEY_0));
        break;
        
    case KEY_DOT:
        if (calc->state != STATE_INPUT_NORMAL) {
            calc->state = STATE_INPUT_NORMAL;
            clear_input(calc);
        }
        // Only add dot if there isn't one already in the current number
        if (!strchr(calc->input_buffer, '.')) {
            append_char(calc, '.');
        }
        break;
        
    case KEY_PLUS:
        append_operator(calc, '+');
        break;
        
    case KEY_MINUS:
        append_operator(calc, '-');
        break;
        
    case KEY_MULTIPLY:
        append_operator(calc, '*');
        break;
        
    case KEY_DIVIDE:
        append_operator(calc, '/');
        break;
        
    case KEY_EQUAL:
        if (calc->state == STATE_INPUT_NORMAL) {
            double result;
            if (calculator_evaluate(calc->input_buffer, &result) == 0) {
                calc->last_result = result;
                snprintf(calc->result_buffer, sizeof(calc->result_buffer), 
                         "%.10g", result);
                calc->state = STATE_SHOW_RESULT;
                calc->new_number = true;
            } else {
                strcpy(calc->error_buffer, "Error");
                calc->state = STATE_SHOW_ERROR;
            }
        }
        break;
        
    case KEY_CLEAR:
        clear_input(calc);
        calc->state = STATE_INPUT_NORMAL;
        memset(calc->result_buffer, 0, sizeof(calc->result_buffer));
        memset(calc->error_buffer, 0, sizeof(calc->error_buffer));
        calc->last_result = 0;
        break;
        
    case KEY_BACKSPACE:
        backspace(calc);
        break;
        
    default:
        // Ignore other keys for now
        break;
    }
}

void calculator_render_ui(struct calculator *calc)
{
    if (!calc) {
        return;
    }
    
    // Clear display
    display_engine_clear();
    
    // Get display dimensions
    int width = display_engine_get_width();
    int height = display_engine_get_height();
    
    // Draw title bar
    display_engine_draw_rect(0, 0, width, 20, 0x333333);
    display_engine_draw_text(5, 5, "Scientific Calculator");
    
    // Draw main display area background
    display_engine_draw_rect(5, 25, width - 10, 60, 0x000000);
    
    // Display content based on current state
    const char *display_text = "";
    int text_y = 30;
    
    switch (calc->state) {
    case STATE_INPUT_NORMAL:
        display_text = calc->input_buffer;
        break;
        
    case STATE_SHOW_RESULT:
        display_engine_draw_text(10, text_y, calc->input_buffer);
        display_engine_draw_text(10, text_y + 15, "=");
        display_text = calc->result_buffer;
        text_y += 30;
        break;
        
    case STATE_SHOW_ERROR:
        display_engine_draw_text(10, text_y, calc->input_buffer);
        display_text = calc->error_buffer;
        text_y += 15;
        break;
        
    default:
        display_text = "Ready";
        break;
    }
    
    // Draw main text
    display_engine_draw_text(10, text_y, display_text);
    
    // Draw status information
    char status[32];
    snprintf(status, sizeof(status), "State: %d", calc->state);
    display_engine_draw_text(5, height - 20, status);
    
    // Present all drawing operations
    display_engine_present();
}

// Simple expression evaluator using recursive descent parser
// This is a basic implementation for +, -, *, / operations
// For a more robust solution, consider using shunting-yard algorithm

typedef struct {
    const char *expr;
    int pos;
    int len;
} parser_t;

static double parse_number(parser_t *p);
static double parse_factor(parser_t *p);
static double parse_term(parser_t *p);
static double parse_expression(parser_t *p);

static void skip_whitespace(parser_t *p)
{
    while (p->pos < p->len && (p->expr[p->pos] == ' ' || p->expr[p->pos] == '\t')) {
        p->pos++;
    }
}

static double parse_number(parser_t *p)
{
    skip_whitespace(p);
    
    if (p->pos >= p->len) {
        return 0;
    }
    
    char *endptr;
    double result = strtod(&p->expr[p->pos], &endptr);
    p->pos += (endptr - &p->expr[p->pos]);
    
    return result;
}

static double parse_factor(parser_t *p)
{
    skip_whitespace(p);
    
    if (p->pos >= p->len) {
        return 0;
    }
    
    if (p->expr[p->pos] == '(') {
        p->pos++; // skip '('
        double result = parse_expression(p);
        skip_whitespace(p);
        if (p->pos < p->len && p->expr[p->pos] == ')') {
            p->pos++; // skip ')'
        }
        return result;
    }
    
    if (p->expr[p->pos] == '-') {
        p->pos++; // skip '-'
        return -parse_factor(p);
    }
    
    if (p->expr[p->pos] == '+') {
        p->pos++; // skip '+'
        return parse_factor(p);
    }
    
    return parse_number(p);
}

static double parse_term(parser_t *p)
{
    double result = parse_factor(p);
    
    while (p->pos < p->len) {
        skip_whitespace(p);
        if (p->pos >= p->len) break;
        
        char op = p->expr[p->pos];
        if (op != '*' && op != '/') {
            break;
        }
        
        p->pos++; // skip operator
        double right = parse_factor(p);
        
        if (op == '*') {
            result *= right;
        } else { // op == '/'
            if (right == 0) {
                return NAN; // Division by zero
            }
            result /= right;
        }
    }
    
    return result;
}

static double parse_expression(parser_t *p)
{
    double result = parse_term(p);
    
    while (p->pos < p->len) {
        skip_whitespace(p);
        if (p->pos >= p->len) break;
        
        char op = p->expr[p->pos];
        if (op != '+' && op != '-') {
            break;
        }
        
        p->pos++; // skip operator
        double right = parse_term(p);
        
        if (op == '+') {
            result += right;
        } else { // op == '-'
            result -= right;
        }
    }
    
    return result;
}

int calculator_evaluate(const char *expression, double *result)
{
    if (!expression || !result) {
        return -EINVAL;
    }
    
    parser_t parser = {
        .expr = expression,
        .pos = 0,
        .len = strlen(expression)
    };
    
    *result = parse_expression(&parser);
    
    // Check for parse errors
    if (isnan(*result) || isinf(*result)) {
        return -EDOM;
    }
    
    return 0;
}
```

## src/calculator_core.h
```c
/*
 * Calculator Core - Compatibility wrapper for new modular structure
 * 
 * This file provides backward compatibility by including the new
 * modular calculator implementation headers.
 */

#ifndef CALCULATOR_CORE_H
#define CALCULATOR_CORE_H

#include "state/calculator_state.h"
#include "ui/calculator_ui.h"
#include "math/expression_evaluator.h"

// Type alias for backward compatibility
typedef calculator_t calculator;

// Function wrappers for backward compatibility
// (The actual implementations are in the respective modules)

#endif /* CALCULATOR_CORE_H */
```

## src/display_engine.c
```c
/*
 * Display Engine Implementation
 * 
 * This module implements high-level display operations using the Zephyr display driver.
 * It abstracts away pixel format details and provides simple drawing primitives.
 */

#include "display_engine.h"
#include "font_data.h"

#include <zephyr/kernel.h>
#include <zephyr/device.h>
#include <zephyr/drivers/display.h>
#include <zephyr/logging/log.h>
#include <string.h>

LOG_MODULE_REGISTER(display_engine, LOG_LEVEL_INF);

// Internal state
static const struct device *display_dev = NULL;
static struct display_capabilities capabilities;
static struct display_buffer_descriptor buf_desc;
static uint8_t frame_buffer[320 * 240 * 4] __aligned(4); // Static allocation for max size
static size_t frame_buffer_size = 0;
static uint32_t bg_color = 0;
static uint32_t fg_color = 0;

// Function pointer for pixel format specific operations
static void (*fill_buffer_fnc)(uint32_t color, uint8_t *buf, size_t buf_size) = NULL;

// Pixel format specific fill functions
static void fill_buffer_argb8888(uint32_t color, uint8_t *buf, size_t buf_size)
{
    for (size_t idx = 0; idx < buf_size; idx += 4) {
        *((uint32_t *)(buf + idx)) = color;
    }
}

static void fill_buffer_rgb888(uint32_t color, uint8_t *buf, size_t buf_size)
{
    for (size_t idx = 0; idx < buf_size; idx += 3) {
        *(buf + idx + 0) = (color >> 16) & 0xFF;
        *(buf + idx + 1) = (color >> 8) & 0xFF;
        *(buf + idx + 2) = (color >> 0) & 0xFF;
    }
}

static void fill_buffer_rgb565(uint32_t color, uint8_t *buf, size_t buf_size)
{
    uint16_t color16 = (uint16_t)color;
    for (size_t idx = 0; idx < buf_size; idx += 2) {
        *(buf + idx + 0) = (color16 >> 8) & 0xFF;
        *(buf + idx + 1) = (color16 >> 0) & 0xFF;
    }
}

static void fill_buffer_bgr565(uint32_t color, uint8_t *buf, size_t buf_size)
{
    uint16_t color16 = (uint16_t)color;
    for (size_t idx = 0; idx < buf_size; idx += 2) {
        *(uint16_t *)(buf + idx) = color16;
    }
}

static void fill_buffer_mono01(uint32_t color, uint8_t *buf, size_t buf_size)
{
    uint8_t fill_value = (color != 0) ? 0xFF : 0x00;
    memset(buf, fill_value, buf_size);
}

static void fill_buffer_mono10(uint32_t color, uint8_t *buf, size_t buf_size)
{
    uint8_t fill_value = (color != 0) ? 0x00 : 0xFF;
    memset(buf, fill_value, buf_size);
}

// Convert RGB888 color to current pixel format
static uint32_t convert_color(uint8_t r, uint8_t g, uint8_t b)
{
    switch (capabilities.current_pixel_format) {
    case PIXEL_FORMAT_ARGB_8888:
        return 0xFF000000 | (r << 16) | (g << 8) | b;
    case PIXEL_FORMAT_RGB_888:
        return (r << 16) | (g << 8) | b;
    case PIXEL_FORMAT_RGB_565:
    case PIXEL_FORMAT_BGR_565:
        return ((r & 0xF8) << 8) | ((g & 0xFC) << 3) | (b >> 3);
    case PIXEL_FORMAT_MONO01:
    case PIXEL_FORMAT_MONO10:
        // Convert to grayscale using standard formula
        return ((r * 299 + g * 587 + b * 114) / 1000) > 128 ? 1 : 0;
    default:
        return 0;
    }
}

int display_engine_init(void)
{
    // Get display device
    display_dev = DEVICE_DT_GET(DT_CHOSEN(zephyr_display));
    if (!device_is_ready(display_dev)) {
        LOG_ERR("Display device not ready");
        return -ENODEV;
    }

    // Get display capabilities
    display_get_capabilities(display_dev, &capabilities);
    LOG_INF("Display: %dx%d, format=%d", 
            capabilities.x_resolution, 
            capabilities.y_resolution,
            capabilities.current_pixel_format);

    // Calculate frame buffer size
    frame_buffer_size = capabilities.x_resolution * capabilities.y_resolution;

    // Setup pixel format specific parameters
    LOG_INF("Setting up pixel format: %d", capabilities.current_pixel_format);
    switch (capabilities.current_pixel_format) {
    case PIXEL_FORMAT_ARGB_8888:
        fill_buffer_fnc = fill_buffer_argb8888;
        frame_buffer_size *= 4;
        bg_color = convert_color(173, 216, 230);  // Light blue background
        fg_color = convert_color(0, 0, 0);        // Black foreground
        break;
    case PIXEL_FORMAT_RGB_888:
        fill_buffer_fnc = fill_buffer_rgb888;
        frame_buffer_size *= 3;
        bg_color = convert_color(173, 216, 230);  // Light blue background
        fg_color = convert_color(0, 0, 0);        // Black foreground
        break;
    case PIXEL_FORMAT_RGB_565:
        fill_buffer_fnc = fill_buffer_rgb565;
        frame_buffer_size *= 2;
        bg_color = convert_color(173, 216, 230);  // Light blue background
        fg_color = convert_color(0, 0, 0);        // Black foreground
        break;
    case PIXEL_FORMAT_BGR_565:
        fill_buffer_fnc = fill_buffer_bgr565;
        frame_buffer_size *= 2;
        bg_color = convert_color(173, 216, 230);  // Light blue background
        fg_color = convert_color(0, 0, 0);        // Black foreground
        break;
    case PIXEL_FORMAT_MONO01:
        fill_buffer_fnc = fill_buffer_mono01;
        frame_buffer_size = DIV_ROUND_UP(frame_buffer_size, 8);
        bg_color = 0;
        fg_color = 1;
        break;
    case PIXEL_FORMAT_MONO10:
        fill_buffer_fnc = fill_buffer_mono10;
        frame_buffer_size = DIV_ROUND_UP(frame_buffer_size, 8);
        bg_color = 0;
        fg_color = 1;
        break;
    default:
        LOG_ERR("Unsupported pixel format: %d", capabilities.current_pixel_format);
        return -ENOTSUP;
    }

    // Check if frame buffer is large enough
    if (frame_buffer_size > sizeof(frame_buffer)) {
        LOG_ERR("Frame buffer too large (%zu bytes), max is %zu", 
                frame_buffer_size, sizeof(frame_buffer));
        return -ENOMEM;
    }

    // Setup buffer descriptor
    buf_desc.buf_size = frame_buffer_size;
    buf_desc.width = capabilities.x_resolution;
    buf_desc.height = capabilities.y_resolution;
    buf_desc.pitch = capabilities.x_resolution;
    buf_desc.frame_incomplete = false;

    // Clear display and turn it on
    display_engine_clear(0x000000); // Clear with black background
    display_blanking_off(display_dev);

    LOG_INF("Display engine initialized successfully");
    return 0;
}

void display_engine_clear(uint32_t color)
{
    if (!display_dev || !fill_buffer_fnc) {
        return;
    }
    
    fill_buffer_fnc(color, frame_buffer, frame_buffer_size);
    bg_color = color;
}

// Helper function to draw a single character
static void draw_char(char ch, int x, int y, uint32_t color)
{
    const uint8_t *char_data = font_get_char_data(ch);
    if (!char_data) {
        return;
    }
    
    for (int row = 0; row < FONT_HEIGHT; row++) {
        uint8_t row_data = char_data[row];
        for (int col = 0; col < FONT_WIDTH; col++) {
            if (row_data & (0x10 >> col)) {  // Check bits 4,3,2,1,0 for 5-bit font
                display_engine_set_pixel(x + col, y + row, color);
            }
        }
    }
}

// Helper function to draw a large character (2x scale)
static void draw_char_large(char ch, int x, int y, uint32_t color)
{
    const uint8_t *char_data = font_get_char_data(ch);
    if (!char_data) {
        return;
    }
    
    for (int row = 0; row < FONT_HEIGHT; row++) {
        uint8_t row_data = char_data[row];
        for (int col = 0; col < FONT_WIDTH; col++) {
            if (row_data & (0x10 >> col)) {  // Check bits 4,3,2,1,0 for 5-bit font
                // Draw 2x2 pixel block
                int px = x + (col * 2);
                int py = y + (row * 2);
                display_engine_set_pixel(px, py, color);
                display_engine_set_pixel(px + 1, py, color);
                display_engine_set_pixel(px, py + 1, color);
                display_engine_set_pixel(px + 1, py + 1, color);
            }
        }
    }
}

void display_engine_draw_text(const char *text, int x, int y, uint32_t color)
{
    if (!text || !display_dev) {
        return;
    }
    
    int char_x = x;
    int char_y = y;
    
    for (const char *p = text; *p; p++) {
        if (*p == '\n') {
            char_y += FONT_HEIGHT + 2;
            char_x = x;
            continue;
        }
        
        draw_char(*p, char_x, char_y, color);
        char_x += FONT_WIDTH;
    }
}

void display_engine_draw_text_large(const char *text, int x, int y, uint32_t color)
{
    if (!text || !display_dev) {
        return;
    }
    
    int char_x = x;
    int char_y = y;
    
    for (const char *p = text; *p; p++) {
        if (*p == '\n') {
            char_y += (FONT_HEIGHT * 2) + 4;
            char_x = x;
            continue;
        }
        
        draw_char_large(*p, char_x, char_y, color);
        char_x += FONT_WIDTH * 2;
    }
}

void display_engine_fill_rect(int x, int y, int w, int h, uint32_t color)
{
    if (!display_dev) {
        return;
    }
    
    // Bounds checking
    if (x < 0 || y < 0 || x >= capabilities.x_resolution || y >= capabilities.y_resolution) {
        return;
    }
    
    if (x + w > capabilities.x_resolution) {
        w = capabilities.x_resolution - x;
    }
    if (y + h > capabilities.y_resolution) {
        h = capabilities.y_resolution - y;
    }
    
    // Draw filled rectangle
    for (int py = y; py < y + h; py++) {
        switch (capabilities.current_pixel_format) {
        case PIXEL_FORMAT_ARGB_8888: {
            uint32_t *line = (uint32_t*)(frame_buffer + 
                py * capabilities.x_resolution * 4 + x * 4);
            for (int col = 0; col < w; col++) {
                line[col] = color;
            }
            break;
        }
        case PIXEL_FORMAT_RGB_888: {
            uint8_t *line = frame_buffer + 
                py * capabilities.x_resolution * 3 + x * 3;
            for (int col = 0; col < w; col++) {
                line[col * 3 + 0] = (color >> 16) & 0xFF;
                line[col * 3 + 1] = (color >> 8) & 0xFF;
                line[col * 3 + 2] = color & 0xFF;
            }
            break;
        }
        case PIXEL_FORMAT_RGB_565:
        case PIXEL_FORMAT_BGR_565: {
            uint16_t *line = (uint16_t*)(frame_buffer + 
                py * capabilities.x_resolution * 2 + x * 2);
            for (int col = 0; col < w; col++) {
                line[col] = (uint16_t)color;
            }
            break;
        }
        default:
            // Monochrome formats - simplified implementation
            break;
        }
    }
}

void display_engine_set_pixel(int x, int y, uint32_t color)
{
    if (!display_dev || x < 0 || y < 0 || 
        x >= capabilities.x_resolution || y >= capabilities.y_resolution) {
        return;
    }
    
    switch (capabilities.current_pixel_format) {
    case PIXEL_FORMAT_ARGB_8888: {
        uint32_t *pixel = (uint32_t*)(frame_buffer + 
            y * capabilities.x_resolution * 4 + x * 4);
        *pixel = color;
        break;
    }
    case PIXEL_FORMAT_RGB_888: {
        uint8_t *pixel = frame_buffer + 
            y * capabilities.x_resolution * 3 + x * 3;
        pixel[0] = (color >> 16) & 0xFF;
        pixel[1] = (color >> 8) & 0xFF;
        pixel[2] = color & 0xFF;
        break;
    }
    case PIXEL_FORMAT_RGB_565:
    case PIXEL_FORMAT_BGR_565: {
        uint16_t *pixel = (uint16_t*)(frame_buffer + 
            y * capabilities.x_resolution * 2 + x * 2);
        *pixel = (uint16_t)color;
        break;
    }
    default:
        // Monochrome formats - simplified implementation
        break;
    }
}

void display_engine_present(void)
{
    if (!display_dev || frame_buffer_size == 0) {
        return;
    }
    
    display_write(display_dev, 0, 0, &buf_desc, frame_buffer);
}

void display_engine_update(void)
{
    // Update/present the display buffer to the screen
    display_engine_present();
}

int display_engine_get_width(void)
{
    return capabilities.x_resolution;
}

int display_engine_get_height(void)
{
    return capabilities.y_resolution;
}

void display_engine_set_blanking(bool on)
{
    if (!display_dev) {
        return;
    }
    
    if (on) {
        display_blanking_on(display_dev);
    } else {
        display_blanking_off(display_dev);
    }
}
```

## src/display_engine.h
```c
/*
 * Display Engine - High-level display abstraction layer
 * 
 * This module provides a clean interface for drawing operations,
 * hiding the low-level display driver details from the application.
 */

#ifndef DISPLAY_ENGINE_H
#define DISPLAY_ENGINE_H

#include <stdint.h>
#include <stdbool.h>

/**
 * @brief Initialize the display engine
 * @return 0 on success, negative error code on failure
 */
int display_engine_init(void);

/**
 * @brief Clear the entire display with specified color
 * @param color Background color (0 for default background)
 */
void display_engine_clear(uint32_t color);

/**
 * @brief Draw text at specified position with color
 * @param text Text string to draw
 * @param x X coordinate (pixels)
 * @param y Y coordinate (pixels) 
 * @param color Text color
 */
void display_engine_draw_text(const char *text, int x, int y, uint32_t color);

/**
 * @brief Draw large text at specified position with color
 * @param text Text string to draw
 * @param x X coordinate (pixels)
 * @param y Y coordinate (pixels) 
 * @param color Text color
 */
void display_engine_draw_text_large(const char *text, int x, int y, uint32_t color);

/**
 * @brief Draw a filled rectangle
 * @param x X coordinate (pixels)
 * @param y Y coordinate (pixels)
 * @param w Width (pixels)
 * @param h Height (pixels)
 * @param color Color value (format depends on display pixel format)
 */
void display_engine_draw_rect(int x, int y, int w, int h, uint32_t color);

/**
 * @brief Fill a rectangle with specified color
 * @param x X coordinate (pixels)
 * @param y Y coordinate (pixels)
 * @param w Width (pixels)
 * @param h Height (pixels)
 * @param color Fill color
 */
void display_engine_fill_rect(int x, int y, int w, int h, uint32_t color);

/**
 * @brief Set a single pixel
 * @param x X coordinate (pixels)
 * @param y Y coordinate (pixels)
 * @param color Pixel color
 */
void display_engine_set_pixel(int x, int y, uint32_t color);

/**
 * @brief Present/flush all drawing operations to the display
 */
void display_engine_present(void);

/**
 * @brief Update/present the display
 */
void display_engine_update(void);

/**
 * @brief Get display width in pixels
 * @return Display width
 */
int display_engine_get_width(void);

/**
 * @brief Get display height in pixels  
 * @return Display height
 */
int display_engine_get_height(void);

/**
 * @brief Turn display on/off
 * @param on true to turn on, false to turn off
 */
void display_engine_set_blanking(bool on);

#endif /* DISPLAY_ENGINE_H */
```

## src/font_data.c
```c
/*
 * Simple 5x7 bitmap font implementation
 */

#include "font_data.h"

// 5x7 font data for printable ASCII characters (32-126)
// Each row is one byte, MSB = leftmost pixel
const uint8_t font_5x7[][FONT_HEIGHT] = {
    // Space (32)
    {0x00, 0x00, 0x00, 0x00, 0x00, 0x00, 0x00},
    // ! (33)
    {0x04, 0x04, 0x04, 0x04, 0x00, 0x04, 0x00},
    // " (34)
    {0x0A, 0x0A, 0x00, 0x00, 0x00, 0x00, 0x00},
    // # (35)
    {0x0A, 0x1F, 0x0A, 0x1F, 0x0A, 0x00, 0x00},
    // $ (36)
    {0x04, 0x0F, 0x14, 0x0E, 0x05, 0x1E, 0x04},
    // % (37)
    {0x18, 0x19, 0x02, 0x04, 0x08, 0x13, 0x03},
    // & (38)
    {0x0C, 0x12, 0x14, 0x08, 0x15, 0x12, 0x0D},
    // ' (39)
    {0x04, 0x04, 0x00, 0x00, 0x00, 0x00, 0x00},
    // ( (40)
    {0x02, 0x04, 0x08, 0x08, 0x08, 0x04, 0x02},
    // ) (41)
    {0x08, 0x04, 0x02, 0x02, 0x02, 0x04, 0x08},
    // * (42)
    {0x00, 0x04, 0x15, 0x0E, 0x15, 0x04, 0x00},
    // + (43)
    {0x00, 0x04, 0x04, 0x1F, 0x04, 0x04, 0x00},
    // , (44)
    {0x00, 0x00, 0x00, 0x00, 0x0C, 0x04, 0x08},
    // - (45)
    {0x00, 0x00, 0x00, 0x1F, 0x00, 0x00, 0x00},
    // . (46)
    {0x00, 0x00, 0x00, 0x00, 0x00, 0x0C, 0x0C},
    // / (47)
    {0x00, 0x01, 0x02, 0x04, 0x08, 0x10, 0x00},
    // 0 (48)
    {0x0E, 0x11, 0x13, 0x15, 0x19, 0x11, 0x0E},
    // 1 (49)
    {0x04, 0x0C, 0x04, 0x04, 0x04, 0x04, 0x0E},
    // 2 (50)
    {0x0E, 0x11, 0x01, 0x02, 0x04, 0x08, 0x1F},
    // 3 (51)
    {0x1F, 0x02, 0x04, 0x02, 0x01, 0x11, 0x0E},
    // 4 (52)
    {0x02, 0x06, 0x0A, 0x12, 0x1F, 0x02, 0x02},
    // 5 (53)
    {0x1F, 0x10, 0x1E, 0x01, 0x01, 0x11, 0x0E},
    // 6 (54)
    {0x06, 0x08, 0x10, 0x1E, 0x11, 0x11, 0x0E},
    // 7 (55)
    {0x1F, 0x01, 0x02, 0x04, 0x08, 0x08, 0x08},
    // 8 (56)
    {0x0E, 0x11, 0x11, 0x0E, 0x11, 0x11, 0x0E},
    // 9 (57)
    {0x0E, 0x11, 0x11, 0x0F, 0x01, 0x02, 0x0C},
    // : (58)
    {0x00, 0x0C, 0x0C, 0x00, 0x0C, 0x0C, 0x00},
    // ; (59)
    {0x00, 0x0C, 0x0C, 0x00, 0x0C, 0x04, 0x08},
    // < (60)
    {0x02, 0x04, 0x08, 0x10, 0x08, 0x04, 0x02},
    // = (61)
    {0x00, 0x00, 0x1F, 0x00, 0x1F, 0x00, 0x00},
    // > (62)
    {0x08, 0x04, 0x02, 0x01, 0x02, 0x04, 0x08},
    // ? (63)
    {0x0E, 0x11, 0x01, 0x02, 0x04, 0x00, 0x04},
    // @ (64)
    {0x0E, 0x11, 0x01, 0x0D, 0x15, 0x15, 0x0E},
    // A (65)
    {0x0E, 0x11, 0x11, 0x11, 0x1F, 0x11, 0x11},
    // B (66)
    {0x1E, 0x11, 0x11, 0x1E, 0x11, 0x11, 0x1E},
    // C (67)
    {0x0E, 0x11, 0x10, 0x10, 0x10, 0x11, 0x0E},
    // D (68)
    {0x1C, 0x12, 0x11, 0x11, 0x11, 0x12, 0x1C},
    // E (69)
    {0x1F, 0x10, 0x10, 0x1E, 0x10, 0x10, 0x1F},
    // F (70)
    {0x1F, 0x10, 0x10, 0x1E, 0x10, 0x10, 0x10},
    // G (71)
    {0x0E, 0x11, 0x10, 0x17, 0x11, 0x11, 0x0F},
    // H (72)
    {0x11, 0x11, 0x11, 0x1F, 0x11, 0x11, 0x11},
    // I (73)
    {0x0E, 0x04, 0x04, 0x04, 0x04, 0x04, 0x0E},
    // J (74)
    {0x07, 0x02, 0x02, 0x02, 0x02, 0x12, 0x0C},
    // K (75)
    {0x11, 0x12, 0x14, 0x18, 0x14, 0x12, 0x11},
    // L (76)
    {0x10, 0x10, 0x10, 0x10, 0x10, 0x10, 0x1F},
    // M (77)
    {0x11, 0x1B, 0x15, 0x15, 0x11, 0x11, 0x11},
    // N (78)
    {0x11, 0x11, 0x19, 0x15, 0x13, 0x11, 0x11},
    // O (79)
    {0x0E, 0x11, 0x11, 0x11, 0x11, 0x11, 0x0E},
    // P (80)
    {0x1E, 0x11, 0x11, 0x1E, 0x10, 0x10, 0x10},
    // Q (81)
    {0x0E, 0x11, 0x11, 0x11, 0x15, 0x12, 0x0D},
    // R (82)
    {0x1E, 0x11, 0x11, 0x1E, 0x14, 0x12, 0x11},
    // S (83)
    {0x0F, 0x10, 0x10, 0x0E, 0x01, 0x01, 0x1E},
    // T (84)
    {0x1F, 0x04, 0x04, 0x04, 0x04, 0x04, 0x04},
    // U (85)
    {0x11, 0x11, 0x11, 0x11, 0x11, 0x11, 0x0E},
    // V (86)
    {0x11, 0x11, 0x11, 0x11, 0x11, 0x0A, 0x04},
    // W (87)
    {0x11, 0x11, 0x11, 0x15, 0x15, 0x1B, 0x11},
    // X (88)
    {0x11, 0x11, 0x0A, 0x04, 0x0A, 0x11, 0x11},
    // Y (89)
    {0x11, 0x11, 0x11, 0x0A, 0x04, 0x04, 0x04},
    // Z (90)
    {0x1F, 0x01, 0x02, 0x04, 0x08, 0x10, 0x1F},
    // [ (91)
    {0x0E, 0x08, 0x08, 0x08, 0x08, 0x08, 0x0E},
    // \ (92)
    {0x00, 0x10, 0x08, 0x04, 0x02, 0x01, 0x00},
    // ] (93)
    {0x0E, 0x02, 0x02, 0x02, 0x02, 0x02, 0x0E},
    // ^ (94)
    {0x04, 0x0A, 0x11, 0x00, 0x00, 0x00, 0x00},
    // _ (95)
    {0x00, 0x00, 0x00, 0x00, 0x00, 0x00, 0x1F},
    // ` (96)
    {0x08, 0x04, 0x00, 0x00, 0x00, 0x00, 0x00},
    // a (97)
    {0x00, 0x00, 0x0E, 0x01, 0x0F, 0x11, 0x0F},
    // b (98)
    {0x10, 0x10, 0x16, 0x19, 0x11, 0x11, 0x1E},
    // c (99)
    {0x00, 0x00, 0x0E, 0x10, 0x10, 0x11, 0x0E},
    // d (100)
    {0x01, 0x01, 0x0D, 0x13, 0x11, 0x11, 0x0F},
    // e (101)
    {0x00, 0x00, 0x0E, 0x11, 0x1F, 0x10, 0x0E},
    // f (102)
    {0x06, 0x09, 0x08, 0x1C, 0x08, 0x08, 0x08},
    // g (103)
    {0x00, 0x00, 0x0F, 0x11, 0x0F, 0x01, 0x0E},
    // h (104)
    {0x10, 0x10, 0x16, 0x19, 0x11, 0x11, 0x11},
    // i (105)
    {0x04, 0x00, 0x0C, 0x04, 0x04, 0x04, 0x0E},
    // j (106)
    {0x02, 0x00, 0x06, 0x02, 0x02, 0x12, 0x0C},
    // k (107)
    {0x10, 0x10, 0x12, 0x14, 0x18, 0x14, 0x12},
    // l (108)
    {0x0C, 0x04, 0x04, 0x04, 0x04, 0x04, 0x0E},
    // m (109)
    {0x00, 0x00, 0x1A, 0x15, 0x15, 0x11, 0x11},
    // n (110)
    {0x00, 0x00, 0x16, 0x19, 0x11, 0x11, 0x11},
    // o (111)
    {0x00, 0x00, 0x0E, 0x11, 0x11, 0x11, 0x0E},
    // p (112)
    {0x00, 0x00, 0x1E, 0x11, 0x1E, 0x10, 0x10},
    // q (113)
    {0x00, 0x00, 0x0D, 0x13, 0x0F, 0x01, 0x01},
    // r (114)
    {0x00, 0x00, 0x16, 0x19, 0x10, 0x10, 0x10},
    // s (115)
    {0x00, 0x00, 0x0E, 0x10, 0x0E, 0x01, 0x1E},
    // t (116)
    {0x08, 0x08, 0x1C, 0x08, 0x08, 0x09, 0x06},
    // u (117)
    {0x00, 0x00, 0x11, 0x11, 0x11, 0x13, 0x0D},
    // v (118)
    {0x00, 0x00, 0x11, 0x11, 0x11, 0x0A, 0x04},
    // w (119)
    {0x00, 0x00, 0x11, 0x11, 0x15, 0x15, 0x0A},
    // x (120)
    {0x00, 0x00, 0x11, 0x0A, 0x04, 0x0A, 0x11},
    // y (121)
    {0x00, 0x00, 0x11, 0x11, 0x0F, 0x01, 0x0E},
    // z (122)
    {0x00, 0x00, 0x1F, 0x02, 0x04, 0x08, 0x1F},
    // { (123)
    {0x02, 0x04, 0x04, 0x08, 0x04, 0x04, 0x02},
    // | (124)
    {0x04, 0x04, 0x04, 0x04, 0x04, 0x04, 0x04},
    // } (125)
    {0x08, 0x04, 0x04, 0x02, 0x04, 0x04, 0x08},
    // ~ (126)
    {0x00, 0x00, 0x08, 0x15, 0x02, 0x00, 0x00}
};

const uint8_t* font_get_char_data(char ch)
{
    if (ch < 32 || ch > 126) {
        return font_5x7[0]; // Return space for invalid characters
    }
    return font_5x7[ch - 32];
}
```

## src/font_data.h
```c
/*
 * Simple 5x7 bitmap font data
 * Each character is 5 pixels wide, 7 pixels tall
 * MSB is leftmost pixel, LSB is rightmost (only 5 bits used per byte)
 */

#ifndef FONT_DATA_H
#define FONT_DATA_H

#include <stdint.h>

#define FONT_WIDTH  5
#define FONT_HEIGHT 7

// Font data: 5x7 bitmap for ASCII 32-126
// Each character uses 7 bytes (one per row)
extern const uint8_t font_5x7[][FONT_HEIGHT];

/**
 * @brief Get font data for a character
 * @param ch ASCII character (32-126)
 * @return Pointer to 7-byte font data, or NULL if invalid
 */
const uint8_t* font_get_char_data(char ch);

#endif /* FONT_DATA_H */
```

## src/keypad_handler.c
```c
/*
 * Keypad Handler Implementation
 * 
 * This module provides unified key input handling, supporting both FIFO simulation
 * (for native_sim) and hardware GPIO inputs (for real hardware).
 */

#include "keypad_handler.h"

#include <zephyr/kernel.h>
#include <zephyr/logging/log.h>

#ifdef CONFIG_ARCH_POSIX
#include <fcntl.h>
#include <unistd.h>
#include <sys/stat.h>
#endif

LOG_MODULE_REGISTER(keypad_handler, LOG_LEVEL_INF);

// Message queue for key events
K_MSGQ_DEFINE(key_msgq, sizeof(key_code_t), 16, 4);

#ifdef CONFIG_ARCH_POSIX
// FIFO-based input for native_sim
#define FIFO_PATH "/tmp/calculator_keypad_fifo"
static int fifo_fd = -1;

// FIFO reader thread
static void fifo_reader_thread(void *arg1, void *arg2, void *arg3)
{
    ARG_UNUSED(arg1);
    ARG_UNUSED(arg2);
    ARG_UNUSED(arg3);
    
    LOG_INF("FIFO reader thread started");
    
    while (1) {
        if (fifo_fd >= 0) {
            key_code_t key;
            ssize_t bytes_read = read(fifo_fd, &key, sizeof(key));
            
            if (bytes_read == sizeof(key)) {
                LOG_INF("Key received from simulator: %d", key);
                k_msgq_put(&key_msgq, &key, K_NO_WAIT);
            } else if (bytes_read < 0) {
                // FIFO might be closed, try to reopen
                close(fifo_fd);
                fifo_fd = open(FIFO_PATH, O_RDONLY | O_NONBLOCK);
            }
        } else {
            // Try to open FIFO
            fifo_fd = open(FIFO_PATH, O_RDONLY | O_NONBLOCK);
        }
        
        // Small delay to avoid busy waiting
        k_msleep(10);
    }
}

// Thread definition
K_THREAD_DEFINE(fifo_reader, 1024, fifo_reader_thread, NULL, NULL, NULL,
                K_PRIO_COOP(10), 0, 0);

static int init_fifo_keypad(void)
{
    LOG_INF("Initializing FIFO-based keypad handler");
    
    // Create FIFO if it doesn't exist
    mkfifo(FIFO_PATH, 0666);
    
    // Try to open FIFO (non-blocking)
    fifo_fd = open(FIFO_PATH, O_RDONLY | O_NONBLOCK);
    if (fifo_fd < 0) {
        LOG_WRN("Could not open FIFO immediately. Will retry in background thread.");
    }
    
    LOG_INF("FIFO keypad initialized. Waiting for simulator at: %s", FIFO_PATH);
    return 0;
}

#else // Hardware GPIO implementation

static int init_gpio_keypad(void)
{
    // TODO: Implement hardware GPIO keypad initialization
    // This would involve:
    // 1. Getting GPIO devices from device tree
    // 2. Configuring pins as inputs with pull-ups
    // 3. Setting up interrupts or scanning matrix
    // 4. Registering callbacks that send messages to key_msgq
    
    LOG_INF("GPIO keypad initialized (placeholder)");
    return 0;
}

#endif // CONFIG_ARCH_POSIX

int keypad_init(void)
{
    LOG_INF("Initializing keypad handler");
    
#ifdef CONFIG_ARCH_POSIX
    return init_fifo_keypad();
#else
    return init_gpio_keypad();
#endif
}

key_code_t keypad_get_key(void)
{
    key_code_t key;
    
    if (k_msgq_get(&key_msgq, &key, K_NO_WAIT) == 0) {
        return key;
    }
    
    return KEY_NONE;
}

key_code_t keypad_wait_key(int timeout_ms)
{
    key_code_t key;
    k_timeout_t timeout = (timeout_ms == 0) ? K_FOREVER : K_MSEC(timeout_ms);
    
    if (k_msgq_get(&key_msgq, &key, timeout) == 0) {
        return key;
    }
    
    return KEY_NONE;
}
```

## src/keypad_handler.h
```c
/*
 * Keypad Handler - Unified input abstraction layer
 *
 * This module provides a unified interface for getting key inputs,
 * supporting both SDL simulation and hardware GPIO inputs.
 */

#ifndef KEYPAD_HANDLER_H
#define KEYPAD_HANDLER_H

/**
 * @brief Key codes for calculator operations
 */
typedef enum {
    KEY_NONE = 0,
    
    // Numbers
    KEY_0, KEY_1, KEY_2, KEY_3, KEY_4,
    KEY_5, KEY_6, KEY_7, KEY_8, KEY_9,
    
    // Basic operations
    KEY_PLUS,      // +
    KEY_MINUS,     // -
    KEY_MULTIPLY,  // *
    KEY_DIVIDE,    // /
    KEY_EQUAL,     // =
    KEY_CLEAR,     // C/AC
    KEY_DOT,       // .
    KEY_BACKSPACE, // Del
    
    // Scientific functions
    KEY_SIN, KEY_COS, KEY_TAN,
    KEY_LOG, KEY_LN, KEY_SQRT,
    KEY_POWER, KEY_FACTORIAL, KEY_PI,
    KEY_E, KEY_PAREN_LEFT, KEY_PAREN_RIGHT,
    
    // Casio fx-991 specific keys
    KEY_SHIFT, KEY_ALPHA, KEY_MODE,
    KEY_ON_AC, KEY_X_POW_Y, KEY_X_POW_MINUS1,
    KEY_LOG10, KEY_EXP, KEY_PERCENT,
    KEY_ANS, KEY_ENG, KEY_SETUP,
    KEY_STAT, KEY_MATRIX, KEY_VECTOR,
    KEY_CMPLX, KEY_BASE_N, KEY_EQUATION,
    KEY_CALC, KEY_SOLVE, KEY_INTEGRATE,
    KEY_DIFF, KEY_TABLE, KEY_RESET,
    KEY_RAN_HASH, KEY_DRG, KEY_HYP,
    KEY_STO, KEY_RCL, KEY_CONST,
    KEY_CONV, KEY_FUNC, KEY_OPTN,
    
    KEY_MAX
} key_code_t;

/**
 * @brief Initialize the keypad handler
 * @return 0 on success, negative error code on failure
 */
int keypad_init(void);

/**
 * @brief Get the next key press (non-blocking)
 * @return Key code, or KEY_NONE if no key pressed
 */
key_code_t keypad_get_key(void);

/**
 * @brief Wait for a key press (blocking)
 * @param timeout_ms Maximum time to wait in milliseconds (0 = wait forever)
 * @return Key code, or KEY_NONE if timeout
 */
key_code_t keypad_wait_key(int timeout_ms);

#endif /* KEYPAD_HANDLER_H */
```
